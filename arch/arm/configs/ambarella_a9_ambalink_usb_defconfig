## arch/arm/plat-ambarella/ambalink/Kconfig
```kconfig
menuconfig PLAT_AMBARELLA_AMBALINK
	bool "AmbaLink Support"
	default n

if PLAT_AMBARELLA_AMBALINK
choice
	prompt "Link Topology"
config AMBALINK_SINGLE_CORE
	bool "Uni_Core"
	select PLAT_AMBARELLA_BOSS
	help 
	  AmbaLink on uni-core platform

config AMBALINK_MULTIPLE_CORE
	bool "Multi_Core"
	select PLAT_AMBARELLA_PPM_UNCACHED
	help
	  AmbaLink on multiple-core (dual-core Cortex) platform

config AMBALINK_AMP_MULTIPLE_CORE
	bool "AMP_Multi_Core"
	select PLAT_AMBARELLA_PPM_UNCACHED
	help
	  AmbaLink on AMP multiple-core (ARM11 + Cortex) platform
endchoice #"Ambalink Topology"

config PLAT_AMBARELLA_BOSS
	bool "Ambarella BOSS"
	default n
	depends on AMBALINK_SINGLE_CORE
	help
	  Enable single core BOSS support.

config AMBALINK_SHMADDR
	hex "shared memory address"
	default 0x00000000
	help
	  Specify the starting address for Ambalink shared memory

config AMBALINK_LOCK
	bool "Amba Global Locks"
       	default y
       	help
	  Ambalink global spin-lock and mutex

config AMBALINK_RPC
	bool "Amba RPC support"
	depends on RPMSG
	default y
	depends on RPROC_SUPPORT
	help 
	  Amblink Remote Procedure Call

config AMBALINK_RFS
	bool "Amba Ramfs server"
	depends on RPMSG
	default y
	help
	  Enable RTOS to read/write ramfs through RPMSG

config RPMSG_SD
	tristate "Amba SD card control"
	depends on RPMSG
	select AMBARELLA_IPC_LOCK
	help
	  SD controller RPMSG host driver.

config RPMSG_CLK
	tristate "Amba Clock"
	depends on RPMSG
	help
	  Ambarella clock RPMSG host driver.

config RPMSG_LINKCTRL
	tristate "Amba Link Control"
	depends on RPMSG
	help
	  A rpmsg server to handle the message between client and server for 
	  control purpose, such as suspend, resume.

source "arch/arm/plat-ambarella/ambalink/ambafs/Kconfig"

endif #PLAT_AMBARELLA_AMBALINK
```

## arch/arm/plat-ambarella/ambalink/ambafs/Kconfig
```kconfig
config AMBALINK_VFS
	tristate "Amba Virutal File System"
	depends on RPMSG
	default m
	help
	  Enable Linux to read/write RTOS native FS"
```

## drivers/net/ethernet/ambarella/Kconfig
```kconfig
#
# AMBARELLA network device configuration
#

config NET_VENDOR_AMBARELLA
	tristate "Ambarella 10/100/1000 GMAC Ethernet support"
	depends on PLAT_AMBARELLA_SUPPORT_ETH
	select CRC32
	select PHYLIB
	select MII
	help
	  This driver supports Ambarella 10/100/1000 GMAC Ethernet.
```

## drivers/net/wireless/ti/Kconfig
```kconfig
menuconfig WL_TI
	bool "TI Wireless LAN support"
	---help---
	  This section contains support for all the wireless drivers
	  for Texas Instruments WLAN chips, such as wl1251 and the wl12xx
	  family.

if WL_TI
source "drivers/net/wireless/ti/wl1251/Kconfig"
source "drivers/net/wireless/ti/wl12xx/Kconfig"
source "drivers/net/wireless/ti/wl18xx/Kconfig"

# keep last for automatic dependencies
source "drivers/net/wireless/ti/wlcore/Kconfig"

comment "Set WL18XX, WLCORE, WLCORE_SDIO, WL12XX_PLATFORM_DATA as m to choose WL18XX in-band."
	depends on !(WL18XX=m && WLCORE=m && WLCORE_SDIO=m && WL12XX_PLATFORM_DATA)

config TI_WL18XX
	bool "TI wl18xx compat-wireless driver"
	depends on MMC
	depends on WL18XX=m && WLCORE=m && WLCORE_SDIO=m && WL12XX_PLATFORM_DATA
	default n
	---help---
	  TI patches for wl18xx driver with in-band SDIO ISR.
	  wl18xx driver will be built by compat-wireless.
	  Note: Official kernel configuration setting is named as WL18XX.


endif # WL_TI
```

## drivers/remoteproc/ambarella/Kconfig
```kconfig
config RPROC_SUPPORT
	bool
	select REMOTEPROC
        select RPMSG
	default n

config RPROC_CA9_A
	tristate "Enable RPROC Host on CA9-A"
	depends on MACH_HYACINTH_0
	select RPROC_SUPPORT
	help
	  TBD:

config RPROC_CA9_B
	tristate "Enable RPROC Host on CA9-B"
	depends on MACH_HYACINTH_1
	select RPROC_SUPPORT
	help
	  TBD:

config RPROC_S2
    tristate "Enable RPROC Host on S2"
    depends on MACH_GINKGO
    select RPROC_SUPPORT
    help
      TBD:
    default n

config RPCLNT_SUPPORT
	bool
	select REMOTEPROC
        select RPMSG
	default n

config RPCLNT_CA9_B
	tristate "Enable RPROC Clnt on CA9-B"
	depends on MACH_HYACINTH_1
	select RPCLNT_SUPPORT
	help
	  TODO:
```

## drivers/rpmsg/ambarella/host/streamer/Kconfig
```kconfig
config RPMSG_STREAMER
	tristate "Streamer"
	depends on RPMSG
	help
	  A sample of rpmsg program which streams A/V frames
```

## sound/soc/ambarella/Kconfig
```kconfig
config SND_AMBARELLA_SOC
	tristate "SoC Audio for the Ambarella chips"
	depends on PLAT_AMBARELLA && SND_SOC
	help
	  Say Y or M if you want to add support for codecs attached to
	  the AMBARELLA I2S interface. You will also need
	  to select the audio interfaces to support below.

config SND_AMBARELLA_SOC_I2S
	tristate

menuconfig SND_AMBARELLA_BOARD
	tristate "Ambarella Board Type"
	depends on SND_AMBARELLA_SOC
	help
	  Say Y or M to select specific ambarella board.

if SND_AMBARELLA_BOARD

config IPCAM_BOARD
	tristate "IPCAM Board [With Internel Codec]"
	depends on SND_AMBARELLA_SOC && PLAT_AMBARELLA_A2
	select SND_AMBARELLA_SOC_I2S
	select SND_SOC_AMBARELLA_A2AUC
	help
	  Say Y if you want to add internal audio codec support for
	  SoC audio on Ambarella IPCAM Board.

config AMBEVK_BOARD
	tristate "EVK Board [With AK4642 Codec]"
	depends on SND_AMBARELLA_SOC && (MACH_COCONUT || MACH_DURIAN || MACH_GINKGO)
	select SND_AMBARELLA_SOC_I2S
	select SND_SOC_AK4642_AMB
	help
	  Say Y if you want to add ak4642 audio codec support for
	  SoC audio on Ambarella EVK Board (COCONUT, DURIAN or Ginkgo Board).

config A5S_PA2_BOARD
	tristate "A5s PA2 board [with WM8737 Codec]"
	depends on SND_AMBARELLA_SOC && (MACH_COCONUT)
	select SND_AMBARELLA_SOC_I2S
	select SND_SOC_WM8737
	help
	  Say Y if you want to add WM8737 codec for A5s PA2 board.

config I1EVK_BOARD
	tristate "I1EVK Board [With WM8994 Codec]"
	depends on SND_AMBARELLA_SOC && MACH_ELEPHANT && MFD_WM8994
	select SND_AMBARELLA_SOC_I2S
	select SND_SOC_WM8994
	select SND_SOC_AMBARELLA_DUMMY
	help
	  Say Y if you want to add wm8994 audio codec support for
	  SoC audio on Ambarella I1EVK Board.

config MD800_BOARD
	tristate "MD800 Board [With ES8328 Codec]"
	depends on SND_AMBARELLA_SOC && MACH_ELEPHANT
	select SND_AMBARELLA_SOC_I2S
	select SND_SOC_ES8328
	help
	  Say Y if you want to add es8328 audio codec support for
	  SoC audio on Ambarella MD800 Board.

config AMBARELLA_DUMMY_BOARD
	tristate "Ambarella Dummy Board [With Dummy Codec]"
	select SND_AMBARELLA_SOC_I2S
	select SND_SOC_AMBARELLA_DUMMY
	help
	  Say Y if you want to add dummy audio codec support for
	  SoC audio on Ambarella Board. Generally, it's for HDMI.

endif
```
